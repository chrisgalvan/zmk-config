## config/west.yml
```yaml
manifest:
  remotes:
    - name: zmkfirmware
      url-base: https://github.com/zmkfirmware
    # dongle
    - name: carrefinho
      url-base: https://github.com/carrefinho
    # nice-view-battery
    - name: infely
      url-base: https://github.com/infely
  projects:
    - name: zmk
      remote: zmkfirmware
      revision: v0.3
      import: app/west.yml
    # dongle
    - name: prospector-zmk-module
      remote: carrefinho
      revision: main
    # nice-view-battery
    - name: nice-view-battery
      remote: infely
      revision: main
  self:
    path: config
```
